## conf/layer.conf
```bitbake
# We have a conf and classes directory, add to BBPATH
BBPATH .= ":${LAYERDIR}"

# We have recipes-* directories, add to BBFILES
BBFILES += "${LAYERDIR}/recipes-*/*/*.bb \
	${LAYERDIR}/recipes-*/*/*.bbappend"

BBFILE_COLLECTIONS += "intel-axxia-testing"
BBFILE_PATTERN_intel-axxia-testing = "^${LAYERDIR}/"
BBFILE_PRIORITY_intel-axxia-testing = "6"

LAYERSERIES_COMPAT_intel-axxia-testing = "thud"
LAYERDEPENDS_intel-axxia-testing = " intel-snr"
```
